## main/Kconfig
```kconfig
config AVAILABLE_BRIDGE_UARTS
    int
    default 1 if SOC_UART_NUM = 2
    default 2 if SOC_UART_NUM = 3
    default 3 if SOC_UART_NUM = 4
    default 4 if SOC_UART_NUM = 5
    default 4 if SOC_UART_NUM = 6
    default 0

menu "Serial TCP Bridge Configuration"
    choice NETWORK_INTERFACE
        prompt "Network Interface"
        default NETWORK_INTERFACE_WIFI
        help
            Select the network interface to use for TCP connections.

        config NETWORK_INTERFACE_WIFI
            bool "WiFi"
            help
                Use WiFi for network connectivity.

        config NETWORK_INTERFACE_ETHERNET
            bool "Ethernet"
            help
                Use Ethernet for network connectivity (ESP32-P4 and other chips with Ethernet support).
    endchoice

    menu "WiFi Configuration"
        depends on NETWORK_INTERFACE_WIFI
        config WIFI_SSID
            string "WiFi SSID"
            default "mywifi"
            help
                SSID (network name) to connect to.

        config WIFI_PASSWORD
            string "WiFi Password"
            default "mypassword"
            help
                WiFi password (WPA or WPA2).
                Can be left blank if the network has no security set.

        config WIFI_MAX_CONNECT_RETRIES
            int "Maximum WiFi connection retries"
            default 10
            range 1 30
            help
                Maximum number of connection attempts before giving up.

        config WIFI_CONNECT_RETRY_INTERVAL
            int "WiFi connection retry interval (ms)"
            default 1000
            range 100 10000
            help
                Time in milliseconds between connection attempts.

        config WIFI_RECONNECT_BASE_DELAY_MS
            int "WiFi reconnect base delay (ms)"
            default 500
            range 100 5000
            help
                Initial backoff delay for WiFi reconnection in milliseconds.

        config WIFI_RECONNECT_MAX_DELAY_MS
            int "WiFi maximum reconnect delay (ms)"
            default 30000
            range 1000 300000
            help
                Maximum backoff delay for WiFi reconnection in milliseconds.
    endmenu

    menu "Ethernet Configuration"
        depends on NETWORK_INTERFACE_ETHERNET

        choice ETH_PHY_MODEL
            prompt "Ethernet PHY Model"
            default ETH_PHY_IP101
            help
                Select the PHY chip model used on your board.

            config ETH_PHY_IP101
                bool "IP101"
                help
                    IP101 PHY chip.

            config ETH_PHY_RTL8201
                bool "RTL8201/SR8201"
                help
                    RTL8201/SR8201 PHY chip.

            config ETH_PHY_LAN87XX
                bool "LAN87xx"
                help
                    LAN8720/LAN8740/LAN8742A PHY chip.

            config ETH_PHY_DP83848
                bool "DP83848"
                help
                    DP83848 PHY chip.

            config ETH_PHY_KSZ80XX
                bool "KSZ80xx"
                help
                    KSZ8041/KSZ8081 PHY chip.
        endchoice

        config ETH_MDC_GPIO
            int "SMI MDC GPIO number"
            default 31
            help
                GPIO number used for SMI clock signal.
                ESP32-P4-Module-DEV-KIT: GPIO31

        config ETH_MDIO_GPIO
            int "SMI MDIO GPIO number"
            default 52
            help
                GPIO number used for SMI data signal.
                ESP32-P4-Module-DEV-KIT: GPIO52

        config ETH_PHY_RST_GPIO
            int "PHY Reset GPIO number"
            default 51
            help
                GPIO number used to reset the PHY chip.
                Set to -1 to disable PHY reset.
                ESP32-P4-Module-DEV-KIT: GPIO51

        config ETH_PHY_ADDR
            int "PHY Address"
            default 1
            range 0 31
            help
                PHY address on the SMI bus (0-31).

        menu "RMII Pin Configuration"
            config ETH_RMII_TX_EN_GPIO
                int "RMII TX_EN GPIO"
                default 49
                help
                    GPIO for RMII TX_EN signal.
                    ESP32-P4-Module-DEV-KIT: GPIO49

            config ETH_RMII_TXD0_GPIO
                int "RMII TXD0 GPIO"
                default 34
                help
                    GPIO for RMII TXD0 signal.
                    ESP32-P4-Module-DEV-KIT: GPIO34

            config ETH_RMII_TXD1_GPIO
                int "RMII TXD1 GPIO"
                default 35
                help
                    GPIO for RMII TXD1 signal.
                    ESP32-P4-Module-DEV-KIT: GPIO35

            config ETH_RMII_RXD0_GPIO
                int "RMII RXD0 GPIO"
                default 29
                help
                    GPIO for RMII RXD0 signal.
                    ESP32-P4: GPIO29

            config ETH_RMII_RXD1_GPIO
                int "RMII RXD1 GPIO"
                default 30
                help
                    GPIO for RMII RXD1 signal.
                    ESP32-P4: GPIO30

            config ETH_RMII_CRS_DV_GPIO
                int "RMII CRS_DV GPIO"
                default 28
                help
                    GPIO for RMII CRS_DV (Carrier Sense/Data Valid) signal.
                    ESP32-P4-Module-DEV-KIT: GPIO28

            config ETH_RMII_REF_CLK_GPIO
                int "RMII REF_CLK GPIO"
                default 50
                help
                    GPIO for RMII reference clock (50MHz).
                    ESP32-P4-Module-DEV-KIT: GPIO50
        endmenu
    endmenu

    #menu "Network Configuration"
    #    config BRIDGE_PORT
    #        int "TCP Server Port"
    #        default 6969
    #        range 1024 65535
    #        help
    #            Port number for TCP server to listen on.
    #endmenu

    menu "UART Configuration"
        config ENABLE_UART_BRIDGES
            int "Number of UART bridges to enable"
            range 1 AVAILABLE_BRIDGE_UARTS
            default 1
            help
                Number of UART bridges to enable (UART0 is reserved for debug).

        config UART_BUF_SIZE
            int "UART Buffer Size"
            default 4096
            range 256 8192
            help
                Size of the UART driver buffer in bytes.

        menu "UART1 Bridge Configuration"
            depends on ENABLE_UART_BRIDGES >= 1

            config UART1_TX_PIN
                int "UART1 TX Pin"
                default 7
                help
                    GPIO pin for UART1 TX.

            config UART1_RX_PIN
                int "UART1 RX Pin"
                default 6
                help
                    GPIO pin for UART1 RX.

            config UART1_BAUD_RATE
                int "UART1 Baud Rate"
                default 1500000
                help
                    Baud rate for UART1.

            config UART1_TCP_PORT
                int "UART1 TCP Port"
                default 6969
                range 1024 65535
                help
                    TCP port for UART1 bridge.
        endmenu

        menu "UART2 Bridge Configuration"
            depends on ENABLE_UART_BRIDGES >= 2 && AVAILABLE_BRIDGE_UARTS >= 2

            config UART2_TX_PIN
                int "UART2 TX Pin"
                default 10
                help
                    GPIO pin for UART2 TX.

            config UART2_RX_PIN
                int "UART2 RX Pin"
                default 9
                help
                    GPIO pin for UART2 RX.

            config UART2_BAUD_RATE
                int "UART2 Baud Rate"
                default 1500000
                help
                    Baud rate for UART2.

            config UART2_TCP_PORT
                int "UART2 TCP Port"
                default 6970
                range 1024 65535
                help
                    TCP port for UART2 bridge.
        endmenu

        menu "UART3 Bridge Configuration"
            depends on ENABLE_UART_BRIDGES >= 3 && AVAILABLE_BRIDGE_UARTS >= 3

            config UART3_TX_PIN
                int "UART3 TX Pin"
                default 17
                help
                    GPIO pin for UART3 TX.

            config UART3_RX_PIN
                int "UART3 RX Pin"
                default 16
                help
                    GPIO pin for UART3 RX.

            config UART3_BAUD_RATE
                int "UART3 Baud Rate"
                default 1500000
                help
                    Baud rate for UART3.

            config UART3_TCP_PORT
                int "UART3 TCP Port"
                default 6971
                range 1024 65535
                help
                    TCP port for UART3 bridge.
        endmenu

        # UART4 Configuration
        menu "UART4 Bridge Configuration"
            depends on ENABLE_UART_BRIDGES >= 4 && AVAILABLE_BRIDGE_UARTS >= 4

            config UART4_TX_PIN
                int "UART4 TX Pin"
                default 19
                help
                    GPIO pin for UART4 TX.

            config UART4_RX_PIN
                int "UART4 RX Pin"
                default 18
                help
                    GPIO pin for UART4 RX.

            config UART4_BAUD_RATE
                int "UART4 Baud Rate"
                default 1500000
                help
                    Baud rate for UART4.

            config UART4_TCP_PORT
                int "UART4 TCP Port"
                default 6972
                range 1024 65535
                help
                    TCP port for UART4 bridge.
        endmenu

        #config UART_PORT
        #    int "UART Port Number"
        #    default 1
        #    range 0 2
        #    help
        #        UART port number (0, 1, or 2).

        #config UART_TX_PIN
        #    int "UART TX Pin"
        #    default 7
        #    range 0 39
        #    help
        #        GPIO pin for UART TX.

        #config UART_RX_PIN
        #    int "UART RX Pin"
        #    default 6
        #    range 0 39
        #    help
        #        GPIO pin for UART RX.

        #config UART_BAUD_RATE
        #    int "UART Baud Rate"
        #    default 1500000
        #    help
        #        Baud rate for UART communication.

        config UART_READ_TIMEOUT_MS
            int "UART Read Timeout (ms)"
            default 20
            range 1 500
            help
                UART read timeout in milliseconds.

    endmenu

    menu "Buffer and Timing Configuration"
        config DATA_BUF_SIZE
            int "Data Transfer Buffer Size"
            default 2048
            range 256 8192
            help
                Size of the buffer used for data transfer between TCP and UART.

        config SELECT_TIMEOUT_MS
            int "Select Timeout (ms)"
            default 1
            range 1 100
            help
                Non-blocking select timeout in milliseconds.

        config TASK_DELAY_MS
            int "Task Delay (ms)"
            default 10
            range 1 100
            help
                Main loop delay in milliseconds to prevent CPU hogging.
    endmenu

    menu "TLS Configuration"
        config TLS_ENABLE
            bool "Enable TLS security"
            default n
            help
                Enable TLS encryption for TCP connections. When enabled, the server
                requires a valid certificate and private key.
            select PARTITION_TABLE_CUSTOM

        config TLS_SERVER_CERT_PATH
            string "Server certificate path"
            default "/spiffs/server.crt"
            depends on TLS_ENABLE
            help
                Path to server certificate file in PEM format.
                The certificate must be stored in SPIFFS.

        config TLS_SERVER_KEY_PATH
            string "Server private key path"
            default "/spiffs/server.key"
            depends on TLS_ENABLE
            help
                Path to server private key file in PEM format.
                The key must be stored in SPIFFS.

        config TLS_CLIENT_VERIFY
            bool "Verify client certificates (mTLS)"
            default n
            depends on TLS_ENABLE
            help
                Enable mutual TLS by requiring and verifying client certificates.
                When enabled, clients must present a certificate signed by the
                configured CA certificate.

        config TLS_CA_CERT_PATH
            string "CA certificate path"
            default "/spiffs/ca.crt"
            depends on TLS_CLIENT_VERIFY
            help
                Path to CA certificate file in PEM format used for verifying
                client certificates. Only needed when client verification is enabled.
                The certificate must be stored in SPIFFS.
    endmenu

endmenu
```

## sdkconfig.defaults
```kconfig
# Disable TLS support (plain TCP mode)
CONFIG_TLS_ENABLE=n

# Use custom partition table
CONFIG_PARTITION_TABLE_CUSTOM=y
CONFIG_PARTITION_TABLE_CUSTOM_FILENAME="partitions.csv"
CONFIG_PARTITION_TABLE_FILENAME="partitions.csv"

# Network Interface - Ethernet (ESP32-P4-Module-DEV-KIT)
CONFIG_NETWORK_INTERFACE_ETHERNET=y

# Enable internal Ethernet MAC
CONFIG_ETH_USE_ESP32_EMAC=y

# Ethernet PHY Configuration - IP101 GRI
CONFIG_ETH_PHY_IP101=y
CONFIG_ETH_PHY_ADDR=1

# Ethernet Management Interface Pins
CONFIG_ETH_MDC_GPIO=31
CONFIG_ETH_MDIO_GPIO=52
CONFIG_ETH_PHY_RST_GPIO=51

# Ethernet RMII Data Interface Pins
CONFIG_ETH_RMII_TX_EN_GPIO=49
CONFIG_ETH_RMII_TXD0_GPIO=34
CONFIG_ETH_RMII_TXD1_GPIO=35
CONFIG_ETH_RMII_RXD0_GPIO=29
CONFIG_ETH_RMII_RXD1_GPIO=30
CONFIG_ETH_RMII_CRS_DV_GPIO=28
CONFIG_ETH_RMII_REF_CLK_GPIO=50

# UART Bridge Configuration
CONFIG_ENABLE_UART_BRIDGES=4
```
